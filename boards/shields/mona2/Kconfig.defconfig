## boards/shields/mona2/Kconfig.defconfig
```kconfig
if SHIELD_MONA2_R

config ZMK_KEYBOARD_NAME
    default "mona2"

config ZMK_BLE
    default y

config ZMK_SPLIT_ROLE_CENTRAL
    default y

config INPUT
    default y

config ZMK_POINTING
    default y

config SPI
    default y

#
# ---- Cirque Pinnacle ----
#
# ここが必要（DTで device が生成されるため）
#
# ※どちらが存在するかは module/zephyr の Kconfig 定義次第
#   - CONFIG_PINNACLE が存在する環境
#   - CONFIG_INPUT_PINNACLE が存在する環境
#
config PINNACLE
    default y

config INPUT_PINNACLE
    default y

#
# ---- PMW3610（旧トラックボール）は使わない ----
# （型なし定義 warning の原因になっていたので無効のまま）
#
# config PMW3610
#     default y

endif


if SHIELD_MONA2_R || SHIELD_MONA2_L

config NFCT_PINS_AS_GPIOS
    default y

config ZMK_SPLIT
    default y

config RGBLED_WIDGET_BATTERY_LEVEL_HIGH
    default 30

config RGBLED_WIDGET_BATTERY_LEVEL_CRITICAL
    default 10

endif
```

## config/west.yml
```yaml
manifest:
  remotes:
    - name: zmkfirmware
      url-base: https://github.com/zmkfirmware
    - name: razilyis
      url-base: https://github.com/razilyis
    - name: caksoylar  # <-- RGB LED
      url-base: https://github.com/caksoylar  
  projects:
    - name: zmk
      remote: zmkfirmware
      revision: v0.3.0
      import: app/west.yml
    - name: zmk-driver-iqs7211e
      remote: razilyis
      revision: master
      path: modules/lib/zmk-driver-iqs7211e
    - name: zmk-rgbled-widget
      remote: caksoylar
      revision: main
  self:
    path: config
```
